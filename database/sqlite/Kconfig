## database/sqlite/Kconfig
```kconfig
#
# For a description of the syntax of this configuration file,
# see the file kconfig-language.txt in the NuttX tools repository.
#

config LIB_SQLITE
	bool "SQLITE library"
	depends on FS_LOCK_BUCKET_SIZE > 0 && FS_LINKS
	default n
	---help---
		SQLite locks its files (FS_LOCK_BUCKET_SIZE) and resolves
		their names with readlink(), which needs FS_LINKS.

if LIB_SQLITE

config LIB_SQLITE_VERSION
	string "SQLITE version"
	default "3.45.1"

config LIB_SQLITE_YEAR
	string "SQLITE release year"
	default "2024"
	---help---
		The year of the version's release: sqlite.org keeps its
		amalgamations under it (www.sqlite.org/<year>/).  Used when
		there is no git checkout in sqlite/.

config LIB_SQLITE_SHA256
	string "SQLITE amalgamation SHA-256"
	default "5592243caf28b2cdef41e6ab58d25d653dfc53deded8450eb66072c929f030c4"
	---help---
		Checked before sqlite.org's amalgamation is unpacked: change it
		with the version and year.

config LIB_SQLITE_SMALL
	bool "Leave out rarely used parts"
	default n
	---help---
		Build without deprecated and shared-cache interfaces, JSON,
		WAL, UTF-16, memory-mapped I/O, declared types, the progress
		and trace callbacks, and the memory statistics, and keep
		temporary tables in memory.  Strings in double quotes are not
		taken as names (SQLITE_DQS=0), LIKE never matches a BLOB, and
		sqlite3_get_table() and Tcl variables are left out, and
		sqlite3_complete() unless the shell (UTILS_SQLITE) is built.
		Saves flash on small systems.

config UTILS_SQLITE
	tristate "SQLite cmd line tool"
	default n

config UTILS_SQLITE_STACKSIZE
	int "SQLite3 cmd line tool stack size"
	default 8192
	depends on UTILS_SQLITE

endif
```

## examples/modem/Kconfig
```kconfig
#
# For a description of the syntax of this configuration file,
# see the file kconfig-language.txt in the NuttX tools repository.
#

config EXAMPLES_MODEM
	tristate "Cellular modem command (AT commands, power, SMS)"
	default n
	depends on DEV_GPIO
	---help---
		A small command for a cellular modem on a serial port that speaks
		3GPP AT commands (27.007/27.005): power it up and down through two
		GPIO devices (supply and PWRKEY), wake it through a third (DTR)
		while it runs, send AT commands, show its identity, SIM, signal
		and network registration, send and read SMS, and pass the console
		through to it.  Written for the SIMCom A7682E on the LilyGo T-Deck
		Max.

if EXAMPLES_MODEM

config EXAMPLES_MODEM_PROGNAME
	string "Program name"
	default "modem"
	---help---
		This is the name of the program that will be used when the NSH ELF
		program is installed.

config EXAMPLES_MODEM_PRIORITY
	int "modem task priority"
	default 100

config EXAMPLES_MODEM_STACKSIZE
	int "modem stack size"
	default DEFAULT_TASK_STACKSIZE

config EXAMPLES_MODEM_TTY
	string "Modem serial port"
	default "/dev/ttyS1"

config EXAMPLES_MODEM_PWR
	string "GPIO device for the modem supply"
	default "/dev/modem_pwr"

config EXAMPLES_MODEM_PWRKEY
	string "GPIO device that presses PWRKEY"
	default "/dev/modem_pwrkey"
	---help---
		Writing 1 presses the key (pulls the modem's PWRKEY low).

config EXAMPLES_MODEM_DTR
	string "GPIO device for the modem's DTR"
	default "/dev/modem_dtr"
	---help---
		Driven low while the command runs, and put back after: a modem
		told to sleep (AT+CSCLK=1) sleeps while DTR is high, and answers
		nothing.  Empty, or a device that does not exist, for none.

config EXAMPLES_MODEM_AWAKE
	string "Device that keeps the system awake"
	default "/dev/awake"
	---help---
		Held open while the command runs, so that the system does not
		sleep while the modem is spoken to: a UART stops in light sleep
		on some chips.  Empty, or a device that does not exist, for none.

endif
```
